## firmware/main/Kconfig.projbuild
```kconfig
menu "Audio bridge"

    config AUDIO_BRIDGE_SERVER_PORT
        int "UDP port the bridge listens on"
        default 5000
        range 1024 65535

endmenu
```
