#pragma once

#include <windows.h>
#include <ole2.h>
#include <wrl/client.h>

#include <algorithm>
#include <atomic>
#include <chrono>
#include <cstdint>
#include <cstdio>
#include <cstring>
#include <future>
#include <memory>
#include <string>
#include <thread>
#include <utility>
#include <vector>

namespace hmi::action::detail
{
inline bool ole_transport_format(UINT format)
{
    if (format < 0xc000) return false;
    wchar_t name[256]{};
    return GetClipboardFormatNameW(format, name, 256) != 0 &&
        (_wcsicmp(name, L"DataObject") == 0 || _wcsicmp(name, L"Ole Private Data") == 0);
}

inline std::string clipboard_error(const char *stage, HRESULT status = E_FAIL, UINT format = 0)
{
    char text[144]{};
    std::snprintf(text, sizeof(text), "ole_snapshot stage=%s format=%u status=0x%08lx", stage, format,
        static_cast<unsigned long>(status));
    return text;
}

// No COM interfaces cross the capture thread boundary. Stream data is frozen
// as bytes; all other handles below are independent, process-owned copies.
struct ClipboardValue
{
    FORMATETC format{};
    HANDLE data = nullptr;
    std::vector<unsigned char> stream;
    std::size_t bytes = 0;

    ClipboardValue() = default;
    ClipboardValue(const ClipboardValue &) = delete;
    ClipboardValue &operator=(const ClipboardValue &) = delete;
    ClipboardValue(ClipboardValue &&other) noexcept : format(other.format), data(std::exchange(other.data, nullptr)),
        stream(std::move(other.stream)), bytes(other.bytes) {}
    ~ClipboardValue()
    {
        if (!data) return;
        if (format.tymed == TYMED_GDI) DeleteObject(data);
        else if (format.tymed == TYMED_ENHMF) DeleteEnhMetaFile(static_cast<HENHMETAFILE>(data));
        else
        {
            if (format.tymed == TYMED_MFPICT)
            {
                auto *picture = static_cast<METAFILEPICT *>(GlobalLock(data));
                if (picture) { DeleteMetaFile(picture->hMF); GlobalUnlock(data); }
            }
            GlobalFree(data);
        }
    }

    bool copy_medium(STGMEDIUM &out) const
    {
        out = {};
        out.tymed = format.tymed;
        if (format.tymed == TYMED_ISTREAM)
        {
            Microsoft::WRL::ComPtr<IStream> result;
            if (FAILED(CreateStreamOnHGlobal(nullptr, TRUE, &result))) return false;
            ULONG written = 0;
            if (!stream.empty() && (FAILED(result->Write(stream.data(), static_cast<ULONG>(stream.size()), &written)) ||
                written != stream.size())) return false;
            LARGE_INTEGER zero{};
            if (FAILED(result->Seek(zero, STREAM_SEEK_SET, nullptr))) return false;
            out.pstm = result.Detach();
            return true;
        }
        if (format.tymed == TYMED_ENHMF)
            out.hEnhMetaFile = CopyEnhMetaFileW(static_cast<HENHMETAFILE>(data), nullptr);
        else
        {
            const CLIPFORMAT base = static_cast<CLIPFORMAT>(format.tymed == TYMED_MFPICT ? CF_METAFILEPICT :
                format.tymed == TYMED_GDI && format.cfFormat != CF_PALETTE ? CF_BITMAP : format.cfFormat);
            out.hGlobal = OleDuplicateData(data, base, 0);
        }
        if (!out.hGlobal) { out = {}; return false; }
        return true;
    }
};

class ClipboardSnapshot
{
public:
    static constexpr std::size_t maximum_formats = 64;
    static constexpr std::size_t maximum_bytes = 32 * 1024 * 1024;
    std::vector<ClipboardValue> values;
    std::size_t bytes = 0;

    bool capture(const std::vector<UINT> &required, const std::atomic<bool> &cancelled, std::string &error)
    {
        Microsoft::WRL::ComPtr<IDataObject> source;
        HRESULT status = OleGetClipboard(&source);
        if (FAILED(status) || !source) { error = clipboard_error("get_object", status); return false; }
        Microsoft::WRL::ComPtr<IEnumFORMATETC> formats;
        status = source->EnumFormatEtc(DATADIR_GET, &formats);
        if (FAILED(status) || !formats) { error = clipboard_error("enumerate", status); return false; }
        for (std::size_t count = 0;; ++count)
        {
            if (cancelled.load()) { error = clipboard_error("cancelled", RPC_E_CALL_CANCELED); return false; }
            FORMATETC format{};
            ULONG fetched = 0;
            status = formats->Next(1, &format, &fetched);
            if (status == S_FALSE && fetched == 0) break;
            const std::unique_ptr<DVTARGETDEVICE, decltype(&CoTaskMemFree)> device(format.ptd, CoTaskMemFree);
            if (status != S_OK || fetched != 1) { error = clipboard_error("enumerate", status); return false; }
            if (count >= maximum_formats) { error = clipboard_error("format_count_limit", E_INVALIDARG); return false; }
            // These are OLE's transport records, regenerated by OleSetClipboard;
            // they are not serialized application payloads or copied handles.
            if (ole_transport_format(format.cfFormat)) continue;
            if (format.ptd) { error = clipboard_error("target_device", DV_E_DVTARGETDEVICE, format.cfFormat); return false; }
            if (!capture_value(source.Get(), format, cancelled, error)) return false;
        }
        // Win32 may expose additional public formats. Preserve those too; never
        // silently discard an entry merely because OLE did not enumerate it.
        for (const UINT required_format : required)
        {
            if (ole_transport_format(required_format)) continue;
            if (std::any_of(values.begin(), values.end(), [required_format](const ClipboardValue &value) {
                return value.format.cfFormat == required_format;
            })) continue;
            FORMATETC format{static_cast<CLIPFORMAT>(required_format), nullptr, DVASPECT_CONTENT, -1,
                TYMED_HGLOBAL | TYMED_GDI | TYMED_MFPICT | TYMED_ENHMF | TYMED_ISTREAM};
            if (!capture_value(source.Get(), format, cancelled, error)) return false;
        }
        if (values.empty()) { error = clipboard_error("no_public_formats", DV_E_FORMATETC); return false; }
        if (cancelled.load()) { error = clipboard_error("cancelled", RPC_E_CALL_CANCELED); return false; }
        return true;
    }

private:
    bool capture_value(IDataObject *source, FORMATETC format, const std::atomic<bool> &cancelled, std::string &error)
    {
        if (cancelled.load()) { error = clipboard_error("cancelled", RPC_E_CALL_CANCELED); return false; }
        if (values.size() >= maximum_formats || format.cfFormat == CF_OWNERDISPLAY ||
            (format.cfFormat >= CF_PRIVATEFIRST && format.cfFormat <= CF_PRIVATELAST) ||
            (format.cfFormat >= CF_GDIOBJFIRST && format.cfFormat <= CF_GDIOBJLAST))
        { error = clipboard_error("unsupported_format", DV_E_FORMATETC, format.cfFormat); return false; }
        struct OwnedMedium
        {
            STGMEDIUM value{};
            ~OwnedMedium() { if (value.tymed != TYMED_NULL) ReleaseStgMedium(&value); }
        } medium;
        const HRESULT status = source->GetData(&format, &medium.value);
        if (FAILED(status)) { error = clipboard_error("get_data", status, format.cfFormat); return false; }
        if (cancelled.load()) { error = clipboard_error("cancelled", RPC_E_CALL_CANCELED); return false; }
        if ((format.tymed & medium.value.tymed) == 0)
        { error = clipboard_error("medium_format_mismatch", DV_E_TYMED, format.cfFormat); return false; }
        ClipboardValue copy;
        copy.format = format;
        copy.format.ptd = nullptr;
        copy.format.tymed = medium.value.tymed;
        const auto budget = maximum_bytes - bytes;
        const auto fail = [&](const char *stage) {
            error = clipboard_error(stage, DV_E_TYMED, format.cfFormat); return false;
        };
        if (medium.value.tymed == TYMED_HGLOBAL)
        {
            if (format.cfFormat == CF_BITMAP || format.cfFormat == CF_PALETTE || format.cfFormat == CF_METAFILEPICT ||
                format.cfFormat == CF_ENHMETAFILE) return fail("medium_format_mismatch");
            copy.bytes = GlobalSize(medium.value.hGlobal);
            if (copy.bytes == 0 || copy.bytes > budget) return fail("size_limit");
            const void *data = GlobalLock(medium.value.hGlobal);
            if (!data) return fail("lock");
            copy.data = GlobalAlloc(GMEM_MOVEABLE, copy.bytes);
            void *destination = copy.data ? GlobalLock(copy.data) : nullptr;
            if (destination) { std::memcpy(destination, data, copy.bytes); GlobalUnlock(copy.data); }
            GlobalUnlock(medium.value.hGlobal);
            if (!destination) return fail("copy");
        }
        else if (medium.value.tymed == TYMED_ISTREAM)
        {
            if (!medium.value.pstm) return fail("null_stream");
            Microsoft::WRL::ComPtr<IStream> stream;
            if (FAILED(medium.value.pstm->Clone(&stream)) || !stream) return fail("stream_clone");
            STATSTG info{};
            if (SUCCEEDED(stream->Stat(&info, STATFLAG_NONAME)) && info.cbSize.QuadPart > budget)
                return fail("size_limit");
            LARGE_INTEGER zero{};
            if (FAILED(stream->Seek(zero, STREAM_SEEK_SET, nullptr))) return fail("stream_seek");
            unsigned char block[16384]{};
            for (;;)
            {
                if (cancelled.load()) return fail("cancelled");
                ULONG read = 0;
                const HRESULT read_status = stream->Read(block, sizeof(block), &read);
                if (FAILED(read_status) || read > sizeof(block)) return fail("stream_read");
                if (read > budget - copy.stream.size()) return fail("size_limit");
                copy.stream.insert(copy.stream.end(), block, block + read);
                if (read_status == S_FALSE || read == 0) break;
            }
            copy.bytes = copy.stream.size();
        }
        else if (medium.value.tymed == TYMED_GDI)
        {
            if (format.cfFormat == CF_PALETTE)
            {
                const UINT entries = GetPaletteEntries(reinterpret_cast<HPALETTE>(medium.value.hBitmap), 0, 0, nullptr);
                if (entries == 0) return fail("palette_size");
                copy.bytes = static_cast<std::size_t>(entries) * sizeof(PALETTEENTRY) + sizeof(LOGPALETTE);
            }
            else if (format.cfFormat == CF_BITMAP || format.cfFormat == CF_DSPBITMAP)
            {
                BITMAP bitmap{};
                if (GetObjectW(medium.value.hBitmap, static_cast<int>(sizeof(bitmap)), &bitmap) != static_cast<int>(sizeof(bitmap)) ||
                    bitmap.bmHeight <= 0 || bitmap.bmWidthBytes <= 0 || bitmap.bmPlanes == 0) return fail("bitmap_size");
                const auto size = static_cast<std::uint64_t>(bitmap.bmHeight) * static_cast<std::uint64_t>(bitmap.bmWidthBytes) *
                    bitmap.bmPlanes;
                if (size > budget) return fail("size_limit");
                copy.bytes = static_cast<std::size_t>(size);
            }
            else return fail("unsupported_gdi");
            if (copy.bytes > budget) return fail("size_limit");
            copy.data = OleDuplicateData(medium.value.hBitmap, format.cfFormat == CF_PALETTE ? CF_PALETTE : CF_BITMAP, 0);
            if (!copy.data) return fail("copy");
        }
        else if (medium.value.tymed == TYMED_ENHMF)
        {
            copy.bytes = GetEnhMetaFileBits(medium.value.hEnhMetaFile, 0, nullptr);
            if (copy.bytes == 0 || copy.bytes > budget) return fail("size_limit");
            copy.data = CopyEnhMetaFileW(medium.value.hEnhMetaFile, nullptr);
            if (!copy.data) return fail("copy");
        }
        else if (medium.value.tymed == TYMED_MFPICT)
        {
            if (GlobalSize(medium.value.hMetaFilePict) < sizeof(METAFILEPICT)) return fail("metafile_size");
            const auto *picture = static_cast<METAFILEPICT *>(GlobalLock(medium.value.hMetaFilePict));
            if (!picture) return fail("lock");
            const UINT size = GetMetaFileBitsEx(picture->hMF, 0, nullptr);
            GlobalUnlock(medium.value.hMetaFilePict);
            if (size == 0 || static_cast<std::uint64_t>(size) + sizeof(METAFILEPICT) > budget) return fail("size_limit");
            copy.bytes = static_cast<std::size_t>(size) + sizeof(METAFILEPICT);
            copy.data = OleDuplicateData(medium.value.hMetaFilePict, CF_METAFILEPICT, 0);
            if (!copy.data) return fail("copy");
        }
        else return fail("unsupported_medium");
        if (copy.bytes > budget) return fail("size_limit");
        bytes += copy.bytes;
        values.push_back(std::move(copy));
        return true;
    }
};

class ClipboardFormats final : public IEnumFORMATETC
{
public:
    explicit ClipboardFormats(std::shared_ptr<const ClipboardSnapshot> snapshot, std::size_t index = 0) :
        snapshot_(std::move(snapshot)), index_(index) {}
    HRESULT STDMETHODCALLTYPE QueryInterface(REFIID id, void **out) override
    {
        if (!out) return E_POINTER;
        *out = nullptr;
        if (id != IID_IUnknown && id != IID_IEnumFORMATETC) return E_NOINTERFACE;
        *out = static_cast<IEnumFORMATETC *>(this); AddRef(); return S_OK;
    }
    ULONG STDMETHODCALLTYPE AddRef() override { return ++references_; }
    ULONG STDMETHODCALLTYPE Release() override { const ULONG left = --references_; if (!left) delete this; return left; }
    HRESULT STDMETHODCALLTYPE Next(ULONG count, FORMATETC *out, ULONG *fetched) override
    {
        if (!out || (!fetched && count != 1)) return E_POINTER;
        ULONG copied = 0;
        while (copied < count && index_ < snapshot_->values.size()) out[copied++] = snapshot_->values[index_++].format;
        if (fetched) *fetched = copied;
        return copied == count ? S_OK : S_FALSE;
    }
    HRESULT STDMETHODCALLTYPE Skip(ULONG count) override
    {
        const auto remaining = snapshot_->values.size() - index_;
        index_ += std::min<std::size_t>(remaining, count);
        return count <= remaining ? S_OK : S_FALSE;
    }
    HRESULT STDMETHODCALLTYPE Reset() override { index_ = 0; return S_OK; }
    HRESULT STDMETHODCALLTYPE Clone(IEnumFORMATETC **out) override
    {
        if (!out) return E_POINTER;
        try { *out = new ClipboardFormats(snapshot_, index_); return S_OK; }
        catch (...) { *out = nullptr; return E_OUTOFMEMORY; }
    }
private:
    std::atomic<ULONG> references_{1};
    std::shared_ptr<const ClipboardSnapshot> snapshot_;
    std::size_t index_ = 0;
};

class ClipboardDataObject final : public IDataObject
{
public:
    explicit ClipboardDataObject(std::shared_ptr<const ClipboardSnapshot> snapshot) : snapshot_(std::move(snapshot)) {}
    HRESULT STDMETHODCALLTYPE QueryInterface(REFIID id, void **out) override
    {
        if (!out) return E_POINTER;
        *out = nullptr;
        if (id != IID_IUnknown && id != IID_IDataObject) return E_NOINTERFACE;
        *out = static_cast<IDataObject *>(this); AddRef(); return S_OK;
    }
    ULONG STDMETHODCALLTYPE AddRef() override { return ++references_; }
    ULONG STDMETHODCALLTYPE Release() override { const ULONG left = --references_; if (!left) delete this; return left; }
    HRESULT STDMETHODCALLTYPE GetData(FORMATETC *format, STGMEDIUM *out) override
    {
        if (!format || !out) return E_POINTER;
        *out = {};
        if (const auto *value = find(*format))
            return value->copy_medium(*out) ? S_OK : STG_E_MEDIUMFULL;
        return DV_E_FORMATETC;
    }
    HRESULT STDMETHODCALLTYPE GetDataHere(FORMATETC *, STGMEDIUM *) override { return E_NOTIMPL; }
    HRESULT STDMETHODCALLTYPE QueryGetData(FORMATETC *format) override
    { return !format ? E_POINTER : find(*format) ? S_OK : DV_E_FORMATETC; }
    HRESULT STDMETHODCALLTYPE GetCanonicalFormatEtc(FORMATETC *, FORMATETC *out) override
    { if (!out) return E_POINTER; out->ptd = nullptr; return E_NOTIMPL; }
    HRESULT STDMETHODCALLTYPE SetData(FORMATETC *, STGMEDIUM *, BOOL) override { return E_NOTIMPL; }
    HRESULT STDMETHODCALLTYPE EnumFormatEtc(DWORD direction, IEnumFORMATETC **out) override
    {
        if (!out) return E_POINTER;
        *out = nullptr;
        if (direction != DATADIR_GET) return E_NOTIMPL;
        try { *out = new ClipboardFormats(snapshot_); return S_OK; }
        catch (...) { return E_OUTOFMEMORY; }
    }
    HRESULT STDMETHODCALLTYPE DAdvise(FORMATETC *, DWORD, IAdviseSink *, DWORD *) override { return OLE_E_ADVISENOTSUPPORTED; }
    HRESULT STDMETHODCALLTYPE DUnadvise(DWORD) override { return OLE_E_ADVISENOTSUPPORTED; }
    HRESULT STDMETHODCALLTYPE EnumDAdvise(IEnumSTATDATA **) override { return OLE_E_ADVISENOTSUPPORTED; }
private:
    const ClipboardValue *find(const FORMATETC &format) const
    {
        if (format.ptd) return nullptr;
        const auto value = std::find_if(snapshot_->values.begin(), snapshot_->values.end(), [&](const ClipboardValue &item) {
            return item.format.cfFormat == format.cfFormat && item.format.dwAspect == format.dwAspect &&
                item.format.lindex == format.lindex && (item.format.tymed & format.tymed) != 0;
        });
        return value == snapshot_->values.end() ? nullptr : &*value;
    }
    std::atomic<ULONG> references_{1};
    std::shared_ptr<const ClipboardSnapshot> snapshot_;
};

enum class ClipboardRestoreResult { Restored, Pending, Failed, Changed };

class ClipboardSnapshotWorker
{
public:
    bool busy() const { return job_ && !complete(); }
    ~ClipboardSnapshotWorker()
    {
        cancel();
        if (!thread_.joinable()) return;
        if (complete()) thread_.join();
        else thread_.detach(); // The read-only job owns itself and never accesses this owner.
    }
    bool capture(const std::vector<UINT> &formats, std::shared_ptr<const ClipboardSnapshot> &out, std::string &error)
    {
        out.reset();
        if (job_)
        {
            if (!complete()) { error = clipboard_error("previous_capture_pending", RPC_E_CALL_CANCELED); return false; }
            thread_.join();
            (void)result_.get();
            job_.reset();
        }
        job_ = std::make_shared<Job>();
        const auto job = job_;
        result_ = job->promise.get_future();
        try
        {
            thread_ = std::thread([job, formats] {
                job->thread.store(GetCurrentThreadId());
                Result result;
                const HRESULT initialized = OleInitialize(nullptr);
                if (SUCCEEDED(initialized))
                {
                    const HRESULT cancellation = CoEnableCallCancellation(nullptr);
                    try
                    {
                        if (FAILED(cancellation)) result.error = clipboard_error("enable_cancellation", cancellation);
                        else
                        {
                            auto snapshot = std::make_shared<ClipboardSnapshot>();
                            if (snapshot->capture(formats, job->cancelled, result.error) && !job->cancelled.load())
                                result.snapshot = std::move(snapshot);
                        }
                    }
                    catch (...) { result.error = clipboard_error("capture_exception", E_UNEXPECTED); }
                    if (SUCCEEDED(cancellation)) CoDisableCallCancellation(nullptr);
                    OleUninitialize();
                }
                else result.error = clipboard_error("sta_initialize", initialized);
                job->promise.set_value(std::move(result));
            });
        }
        catch (...) { job_.reset(); error = clipboard_error("start_capture", E_FAIL); return false; }
        if (result_.wait_for(std::chrono::milliseconds(500)) != std::future_status::ready)
        {
            cancel();
            error = clipboard_error("capture_timeout_500ms", RPC_E_CALL_CANCELED);
            return false;
        }
        thread_.join();
        auto result = result_.get();
        job_.reset();
        out = std::move(result.snapshot);
        error = std::move(result.error);
        return static_cast<bool>(out);
    }
    ClipboardRestoreResult restore(std::shared_ptr<const ClipboardSnapshot> snapshot, HWND owner, DWORD sequence,
                                   std::string &error)
    {
        if (job_)
        {
            if (!complete()) { error = clipboard_error("previous_ole_job_pending"); return ClipboardRestoreResult::Failed; }
            thread_.join();
            (void)result_.get();
            job_.reset();
        }
        job_ = std::make_shared<Job>();
        const auto job = job_;
        job->restoring = true;
        const auto deadline = std::chrono::steady_clock::now() + std::chrono::milliseconds(500);
        result_ = job->promise.get_future();
        try
        {
            thread_ = std::thread([job, snapshot = std::move(snapshot), owner, sequence, deadline] {
                job->thread.store(GetCurrentThreadId());
                Result result;
                const HRESULT initialized = OleInitialize(nullptr);
                if (SUCCEEDED(initialized))
                {
                    try
                    {
                        Microsoft::WRL::ComPtr<IDataObject> object;
                        object.Attach(new ClipboardDataObject(snapshot));
                        if (GetClipboardOwner() != owner || GetClipboardSequenceNumber() != sequence)
                        {
                            result.restore = ClipboardRestoreResult::Changed;
                            result.error = clipboard_error("restore_clipboard_changed");
                        }
                        else
                        {
                            // This CAS is the publish/cancel gate. A timed-out
                            // uncommitted job can never later call OleSetClipboard.
                            int pending = 0;
                            if (std::chrono::steady_clock::now() >= deadline ||
                                !job->stage.compare_exchange_strong(pending, 1))
                                result.error = clipboard_error("restore_cancelled_before_publish", RPC_E_CALL_CANCELED);
                            else if (GetClipboardOwner() != owner || GetClipboardSequenceNumber() != sequence)
                            {
                                result.restore = ClipboardRestoreResult::Changed;
                                result.error = clipboard_error("restore_clipboard_changed");
                            }
                            else
                            {
                                const HRESULT placed = OleSetClipboard(object.Get());
                                if (FAILED(placed)) result.error = clipboard_error("restore_set", placed);
                                else
                                {
                                    job->stage.store(2);
                                    // Once published, retain the STA source and
                                    // pump until flushed or replaced. Never Set
                                    // again, and never flush a user's newer object.
                                    for (;;)
                                    {
                                        const HRESULT current = OleIsCurrentClipboard(object.Get());
                                        if (current == S_FALSE)
                                        {
                                            result.restore = ClipboardRestoreResult::Changed;
                                            result.error = clipboard_error("restore_replaced_by_user", S_FALSE);
                                            break;
                                        }
                                        if (current == S_OK && SUCCEEDED(OleFlushClipboard()))
                                        {
                                            result.restore = ClipboardRestoreResult::Restored;
                                            result.error = "ole_restore=flushed";
                                            break;
                                        }
                                        MSG message{};
                                        while (PeekMessageW(&message, nullptr, 0, 0, PM_REMOVE))
                                        { TranslateMessage(&message); DispatchMessageW(&message); }
                                        MsgWaitForMultipleObjectsEx(0, nullptr, 10, QS_ALLINPUT, MWMO_INPUTAVAILABLE);
                                    }
                                }
                            }
                        }
                    }
                    catch (...) { result.error = clipboard_error("restore_exception", E_UNEXPECTED); }
                    OleUninitialize();
                }
                else result.error = clipboard_error("restore_sta_initialize", initialized);
                job->promise.set_value(std::move(result));
            });
        }
        catch (...) { job_.reset(); error = clipboard_error("start_restore"); return ClipboardRestoreResult::Failed; }
        if (result_.wait_for(std::chrono::milliseconds(500)) != std::future_status::ready)
        {
            cancel();
            if (job->stage.load() < 0)
            {
                error = clipboard_error("restore_cancelled_before_publish", RPC_E_CALL_CANCELED);
                return ClipboardRestoreResult::Failed;
            }
            error = "ole_restore=pending; committed source retained by owned STA until flushed or replaced";
            return ClipboardRestoreResult::Pending;
        }
        thread_.join();
        auto result = result_.get();
        job_.reset();
        error = std::move(result.error);
        return result.restore;
    }
private:
    struct Result
    {
        std::shared_ptr<const ClipboardSnapshot> snapshot;
        std::string error;
        ClipboardRestoreResult restore = ClipboardRestoreResult::Failed;
    };
    struct Job
    {
        std::atomic<bool> cancelled{false};
        std::atomic<DWORD> thread{0};
        bool restoring = false;
        std::atomic<int> stage{0}; // 0=pending, -1=cancelled, 1=publish committed, 2=published.
        std::promise<Result> promise;
    };
    bool complete() const
    { return result_.valid() && result_.wait_for(std::chrono::milliseconds(0)) == std::future_status::ready; }
    void cancel() const
    {
        if (!job_) return;
        if (job_->restoring)
        {
            int pending = 0;
            if (!job_->stage.compare_exchange_strong(pending, -1)) return;
        }
        job_->cancelled.store(true);
        const DWORD thread = job_->thread.load();
        if (thread) CoCancelCall(thread, 0);
    }
    std::shared_ptr<Job> job_;
    std::future<Result> result_;
    std::thread thread_;
};
}
